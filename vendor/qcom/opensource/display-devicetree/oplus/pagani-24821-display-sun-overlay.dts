/dts-v1/;
/plugin/;
#include <dt-bindings/oplus/hw-id.h>
#include "../display/sun-sde-display-mtp-v8-overlay.dts"
#include "sun-display-overlay-common.dtsi"
#include "pagani-24821-display-sun-overlay.dtsi"

/ {
	model = "Qualcomm Technologies, Inc. Sun MTP,pagani";

	oplus,project-id = <24821 24875>;
};