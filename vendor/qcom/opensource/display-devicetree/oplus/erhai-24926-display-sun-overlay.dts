/dts-v1/;
/plugin/;
#include <dt-bindings/oplus/hw-id.h>
#include "../display/sun-sde-display-mtp-v8-overlay.dts"
#include "sun-display-overlay-common.dtsi"
#include "erhai-24926-display-sun-overlay.dtsi"

/ {
	model = "Qualcomm Technologies, Inc. Sun MTP,erhai-O";

	oplus,project-id = <24926 24976>;
};

&mdss_dsi_phy0 {
	oplus,dsi-pll-ssc-disalbed;
};

&mdss_dsi_phy1 {
	oplus,dsi-pll-ssc-disalbed;
};
