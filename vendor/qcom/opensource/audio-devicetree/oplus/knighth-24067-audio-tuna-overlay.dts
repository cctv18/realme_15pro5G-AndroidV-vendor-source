/dts-v1/;
/plugin/;
#include <dt-bindings/oplus/hw-id.h>
#include "../tuna-audio-mtp.dts"
#include "tuna-audio-overlay-common.dtsi"
#include "knighth-24067-audio-tuna-overlay.dtsi"

/ {
    model = "Qualcomm Technologies, Inc. Tuna MTP,knighth";

    oplus,project-id = <24067 24295>;
};
