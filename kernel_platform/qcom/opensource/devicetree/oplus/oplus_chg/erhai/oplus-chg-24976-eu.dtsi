/* BQ pack gauge, svooc-80w, no-ufcs, pps-55w */
#include "oplus-chg-erhai-common.dtsi"
#include "oplus-chg-export.dtsi"
#include "oplus-chg-pack-gauge.dtsi"

&oplus_cpa {
	oplus,protocol_list = <CHG_PROTOCOL_VOOC 80
				   CHG_PROTOCOL_PPS  55
				   CHG_PROTOCOL_PD   18
				   CHG_PROTOCOL_QC   18>;
	oplus,default_protocol_list = <CHG_PROTOCOL_PD
					   CHG_PROTOCOL_PPS
					   CHG_PROTOCOL_VOOC>;
};

&oplus_sc8547a {
	oplus_spec,external_gauge_support;
};
