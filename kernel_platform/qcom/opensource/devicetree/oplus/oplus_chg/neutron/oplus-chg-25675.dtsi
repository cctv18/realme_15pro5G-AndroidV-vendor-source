/* qcom battery gauge, svooc-80w, pps, no-ufcs */
#include "oplus-chg-neutron-common.dtsi"
#include "oplus-chg-qbg.dtsi"

&oplus_cpa {
	oplus,protocol_list = <CHG_PROTOCOL_VOOC 80
				CHG_PROTOCOL_PPS  33
				CHG_PROTOCOL_PD   18
				CHG_PROTOCOL_QC   18>;
	oplus,default_protocol_list = <CHG_PROTOCOL_VOOC
					CHG_PROTOCOL_PPS
					CHG_PROTOCOL_PD>;
};
